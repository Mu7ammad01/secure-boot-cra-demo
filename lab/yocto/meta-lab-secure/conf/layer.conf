## lab/yocto/meta-lab-secure/conf/layer.conf
```bitbake
BBPATH .= ":${LAYERDIR}"
BBFILES += "${LAYERDIR}/recipes-*/*/*.bb ${LAYERDIR}/recipes-*/*/*.bbappend"
BBFILE_COLLECTIONS += "lab-secure"
BBFILE_PATTERN_lab-secure = "^${LAYERDIR}/"
BBFILE_PRIORITY_lab-secure = "9"
LAYERSERIES_COMPAT_lab-secure = "dunfell"
```
